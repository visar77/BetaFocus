#include <BluetoothSerial.h>
#include <SPI.h>
#include <Wire.h>
#include <Adafruit_GFX.h>
#include <Adafruit_SSD1306.h>

#define DEBUG 1

BluetoothSerial SerialBT;

#if DEBUG == 1
#define debug(x) SerialBT.print(x)
#define debugln(x) SerialBT.println(x)
#else
#define debug(x)
#define debugln(x)
#endif

#define SCREEN_WIDTH 128 // OLED display width, in pixels
#define SCREEN_HEIGHT 64 // OLED display height, in pixels
#define OLED_RESET     -1 // Reset pin # (or -1 if sharing Arduino reset pin)
#define SCREEN_ADDRESS 0x3C ///< See datasheet for Address
Adafruit_SSD1306 display(SCREEN_WIDTH, SCREEN_HEIGHT, &Wire, OLED_RESET);

// Global variables for package parsing
const int MAX_LENGTH = 173;
int thirdLastByte = 0;
unsigned char entirePackage[173] = {0}; // for incoming serial data
unsigned char payload[256] = {0};
unsigned char attention = 255;
unsigned char quality = 255;
int lastByte = 0;
int secondLastByte = 0;
int checksum = 0;
int payLoadLength = 0;
bool synced = false;
int i = 0;

// Global variables for drawing
#define GRAPH_HEIGHT 46
uint8_t graph_data[SCREEN_WIDTH] = {0};
uint8_t head_index = 0;
static const unsigned char PROGMEM logo_bitmap[] = {
	0x00, 0x00, 0x00, 0x00, 0x00, 0x00, 0x00, 0x00, 0x00, 0x00, 0x00, 0x00, 0x00, 0x00, 0x00, 0x00,
	0x00, 0x00, 0x00, 0x00, 0x00, 0x00, 0x00, 0x00, 0x00, 0x00, 0x00, 0x00, 0x00, 0x00, 0x00, 0x00,
	0x00, 0x00, 0x00, 0x00, 0x00, 0x00, 0x00, 0x00, 0x00, 0x00, 0x00, 0x00, 0x00, 0x00, 0x00, 0x00,
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	0x00, 0x00, 0x00, 0x00, 0x00, 0x00, 0x00, 0x00, 0x00, 0x00, 0x00, 0x00, 0x00, 0x00, 0x00, 0x00
};

void drawGraph(){
  uint8_t i;
  for (i = 0; i < SCREEN_WIDTH; ++i){
    display.drawLine(SCREEN_WIDTH - i, GRAPH_HEIGHT - graph_data[head_index], SCREEN_WIDTH-i, GRAPH_HEIGHT, SSD1306_WHITE);
    head_index = (head_index + 1) % SCREEN_WIDTH;
  }
}

void addDataToGraph(uint8_t data){
  head_index = head_index == 0 ? head_index = SCREEN_WIDTH-1 : head_index-1 ;
  graph_data[head_index] = (uint8_t)(data * (GRAPH_HEIGHT/100.));
}

void draw() {
  display.clearDisplay();
  //
  display.setCursor(2, GRAPH_HEIGHT+2);
  display.print(F("QLTY:"));

  display.setCursor(SCREEN_WIDTH/4 +2, GRAPH_HEIGHT+2);

  if (quality == 255) display.print(F("-")); //Replace with Signal Quality
  else display.print(quality);

  display.setCursor(SCREEN_WIDTH/2 +3, GRAPH_HEIGHT+2);
  display.print(F("ATTN:"));

  display.setCursor((SCREEN_WIDTH/4) *3 +3, GRAPH_HEIGHT+2);

  unsigned char data = 0;
  if (attention == 255) display.print(F("-")); //Replace with Attention value
  else {
    data = attention;
    display.print(attention);
  }
  addDataToGraph(data);
  drawGraph();
  display.display();
}

/* Returns
 * 1 if payload could be parsed without issed
 * 0 if package couldn't be read, because the CHECKSUM was false or PAYLOADLENGTH is too long
 */
int parsePayload(void) {
  //Serial.println("reached");
  int extendedCodeLevel = 0;
  int index = 0;

  unsigned char meditation;
  unsigned int raw_wave;
  unsigned int waves[8] = {0};
  unsigned int all_values[12] = {0};

  debugln("-----------------------------------");

  while (index < payLoadLength) {
    while (payload[index] == 0x55) {
      extendedCodeLevel++;
      index++;
    }
    //Serial.println("reached2");
    int code = payload[index];
    if (code == 0x02) {
      debug("SIGNAL_QUALITY (0-100): ");
      all_values[0] = (200 - payload[++index]) / 2;
      quality = (unsigned char) all_values[0];
      debugln(all_values[0]);
    } else if (code == 0x04) {
      debug("ATTENTION (0 to 100): ");
      all_values[1] = payload[++index];
      attention = (unsigned char) all_values[1];
      debugln(all_values[1]);
    } else if (code == 0x05) {
      debug("MEDITATION (0 to 100): ");
      all_values[2] = payload[++index];
      debugln(all_values[2]);
    } else if (code == 0x80) {
      int length = payload[++index];
      if (length != 2) {
        debugln("LENGTH OF RAW_VALUES WAS NOT 2!!! ERROR!!!");
        return 0;
      }
      short raw = (payload[index + 2] >> 8) | payload[index + 1];
      index += 2;
      debug("Raw wave value (-32768 to 32767): ");
      all_values[3] = payload[++index];
      debugln(all_values[3]);
    } else if (code == 0x83) {
      int length = payload[++index];
      if (length != 24) {
        debugln("LENGTH OF EEG_POWERS WAS NOT 24!!! ERROR!!!");
        return 0;
      }
      //Serial.print("length:");
      //Serial.println(length);
      for (int j=0; j<8; j++) {
        //Serial.println("RECHEDASDADAS");
        unsigned int first_int = payload[++index];
        unsigned int second_int = payload[++index];
        unsigned int third_int = payload[++index];
        waves[j] = ((first_int << 16) | (second_int << 8) | (third_int));
        all_values[j+3] = waves[j];
        if (j == 0) debug("Delta");
        else if (j == 1) debug("Theta");
        else if (j == 2) debug("Low-Alpha");
        else if (j == 3) debug("High-Alpha");
        else if (j == 4) debug("Low-Beta");
        else if (j == 5) debug("High-Beta");
        else if (j == 6) debug("Low-Gamma");
        else debug("Mid-Gamma");
        debug("-Wave: ");
        debugln(waves[j]);
      }
    }
    index++;
  }
  SerialBT.print("CSV: ");
  for (int j=0; j<11; j++) {
    SerialBT.print(all_values[j]);
    SerialBT.print(";");
  }
  SerialBT.println(all_values[11]);
  debugln("-----------------------------------");


  return 1;
}

/* Returns
 * 1 if package was read without any issue
 * 0 if package couldn't be read, because the CHECKSUM was false or PAYLOADLENGTH is too long
 * -1 if still not done reading the package
 */
int readPackage() {
  // check if there are bytes to be read, if not stop and return
  if (Serial.available() <= 0) {
    return -1;
  }
  // check if package is synced, if so, you can start parsing and checking the package
  if (synced) {
    int index = 0;
    int checksumPackage = 0;
    Serial.readBytes(payload, payLoadLength);
    debug("Payload: ");
    for (int j=0; j<payLoadLength; j++) {
      debug(payload[j]);
      debug(" ");
      Serial.println("Adding payload");
      checksumPackage += payload[j];
    }
    debugln();
    checksumPackage &= 255;
    checksumPackage = ~checksumPackage & 255;
    checksum = Serial.read();
    synced = false;
    if (checksum == checksumPackage) {
      //Serial.println("CHECKSUMM AND PARSING WILL HAPPEN NOW");
      debugln("Checksum matches");
      // Parse the package and return error code from function parsePayload()
      int success = parsePayload();
      return success;
    }
    // CHECKSUM DOESNT MATCH RETURN 0
    debugln("FAILED: CHECKSUM NOT MATCHING");
    return 0;
  }
  //
  lastByte = Serial.read();
  if (lastByte != 170 && secondLastByte == 170 && thirdLastByte == 170 && !synced) {
      if (lastByte > 170) {
        debugln("FAILED: PAYLOADLENGTH TOO LONG");
        return 0;
      }
      entirePackage[0] = 170; //SYNC
      entirePackage[1] = 170; //SYNC
      entirePackage[2] = lastByte;
      payLoadLength = lastByte;
      debug("Payloadlength: ");
      debugln(payLoadLength);
      i = 0;
      synced = true;
  }
  secondLastByte = lastByte;
  thirdLastByte = secondLastByte;
  return -1;
}

void setup() {
  Serial.begin(9600);
  SerialBT.begin("BetaFocus Device", false);

  if(!display.begin(SSD1306_SWITCHCAPVCC, SCREEN_ADDRESS)) {
    Serial.println("SSD1306 allocation failed");
    debugln("SSD1306 allocation failed");
    while (true); // Don't proceed, loop forever
  }

  display.clearDisplay();
  display.drawBitmap(0, 0, logo_bitmap, 128, 64, SSD1306_WHITE);
  display.display();
  display.setTextSize(1);
  display.setTextColor(SSD1306_WHITE);

  delay(3000);
  draw();
}

void loop() {
  // Read the package and get error code
  int success = readPackage();

  // If still not doe reading the package, try again
  if (success == -1) return;
  // If package was read, but contained an error, set attention = 255, indicating, that attention was not read
  if (success == 0) {
    attention = 255;
  }
  // Update display
  draw();
}